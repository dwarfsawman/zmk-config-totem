## Kconfig
```kconfig
# SPDX-License-Identifier: MIT

config ZMK_BEHAVIOR_GATED_MOUSE_MOVE
    bool
    default y
    depends on DT_HAS_ZMK_BEHAVIOR_GATED_MOUSE_MOVE_ENABLED
    depends on ZMK_POINTING
```

## dts/bindings/behaviors/zmk,behavior-gated-mouse-move.yaml
```yaml
# SPDX-License-Identifier: MIT

description: Mouse movement that stops when a configured layer is deactivated

compatible: "zmk,behavior-gated-mouse-move"

include: one_param.yaml

properties:
  bindings:
    type: phandles
    required: true
    description: The mouse movement behavior to invoke
  stop-layer:
    type: int
    required: true
    description: The layer whose deactivation releases all active movements
```
